## Board/hpm5361/Kconfig.defconfig
```kconfig
# Copyright 2026 Dust HeavyHero Project
# SPDX-License-Identifier: Apache-2.0

if BOARD_HPM5361ICB

config HEAP_MEM_POOL_SIZE
	default 8192

config BUILD_OUTPUT_HEX
	default y

config NOCACHE_MEMORY
	default y

endif # BOARD_HPM5361ICB
```

## Board/hpm5361/board.yml
```yaml
board:
  name: hpm5361icb
  full_name: Dust HeavyHero HPM5361ICB
  vendor: hpmicro
  socs:
    - name: hpm5361
```

## Board/hpm5361/dts/bindings/sensor/invensense,icm42688p-hxy.yaml
```yaml
# SPDX-License-Identifier: Apache-2.0

description: ICM-42688P-HXY connected through SPI2

compatible: "invensense,icm42688p-hxy"

include: spi-device.yaml

properties:
  int1-gpios:
    type: phandle-array
    required: true
    description: Data-ready interrupt 1

  int2-gpios:
    type: phandle-array
    required: true
    description: Data-ready interrupt 2
```

## Kconfig
```kconfig
mainmenu "Dust HeavyRobot"

source "Kconfig.zephyr"

choice IMU_DEVICE
    prompt "IMU device"
    default IMU_DEVICE_ICM42688P_HXY

config IMU_DEVICE_ICM42688P_HXY
    bool "ICM-42688P-HXY"

config IMU_DEVICE_HI14R3_ICM42688P_HXY
    bool "HI14R3 + ICM-42688P-HXY"
    help
      Reserve the combined inertial solution. The HI14R3 driver and fusion
      module are intentionally not included yet; the task still acquires ICM.

endchoice
```

## boards/hpm5361/Kconfig.defconfig
```kconfig
if BOARD_HPM5361ICB

config HEAP_MEM_POOL_SIZE
	default 8192

config BUILD_OUTPUT_HEX
	default y

config NOCACHE_MEMORY
	default y

endif
```

## boards/hpm5361/hpm5361icb_defconfig
```kconfig
CONFIG_XIP=y
CONFIG_HPM_BOOT_HEADER=y

CONFIG_CONSOLE=y
CONFIG_UART_CONSOLE=y

CONFIG_PINCTRL=y
CONFIG_PINCTRL_HPMICRO=y

CONFIG_GPIO=y
CONFIG_GPIO_HPMICRO=y

CONFIG_SERIAL=y
CONFIG_UART_HPMICRO=y

CONFIG_DMA=y
CONFIG_DMAV2_HPMICRO=y

CONFIG_SPI_HPMICRO=y
CONFIG_SPI_HPM_SPI_DMA=y
CONFIG_SPI_NOR=y

CONFIG_PWM=y
CONFIG_PWM_HPMICRO=y

CONFIG_CAN=y
CONFIG_MCAN_HPMICRO=y

CONFIG_FLASH=y
CONFIG_FLASH_HPMICRO=y
CONFIG_FLASH_MAP=y

CONFIG_NOCACHE_MEMORY=y
```
